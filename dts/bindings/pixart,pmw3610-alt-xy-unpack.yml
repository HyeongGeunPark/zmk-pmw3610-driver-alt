## dts/bindings/pixart,pmw3610-alt-xy-unpack.yml
```yaml
description: |
  Receiving side of the `packed-xy` property of pixart,pmw3610-alt.

  Listens to another input device, turns each packed X/Y event back into an
  X event and a Y event, and passes every other event on unchanged. On a ZMK
  split central, set `device` to the zmk,input-split proxy of the sensor and
  point the zmk,input-listener at this node instead of at the proxy.

compatible: "pixart,pmw3610-alt-xy-unpack"

properties:
  device:
    type: phandle
    required: true
    description: Input device whose events are unpacked and re-emitted.
  x-input-code:
    type: int
    default: 0
    description: Code of the X event to emit. Defaults to INPUT_REL_X.
  y-input-code:
    type: int
    default: 1
    description: Code of the Y event to emit. Defaults to INPUT_REL_Y.
```

## dts/bindings/pixart,pmw3610-alt.yml
```yaml
description: |
  Sensor driver for the pixart PMW3610 mouse sensor 

compatible: "pixart,pmw3610-alt"

include: spi-device.yaml

properties:
  irq-gpios:
    type: phandle-array
    required: true
  cpi:
    type: int
    default: 600
    description: "CPI value (Range: 200 - 3200, Step: 200)"
  swap-xy:
    type: boolean
  invert-x:
    type: boolean
  invert-y:
    type: boolean
  evt-type:
    type: int
    required: true
  x-input-code:
    type: int
    required: true
  y-input-code:
    type: int
    required: true
  force-awake:
    type: boolean
  force-awake-4ms-mode:
    type: boolean
  packed-xy:
    type: boolean
    description: |
      Report a frame that moved on both axes as one packed event instead of
      an X event and a Y event, which halves the notifications such a frame
      costs over a split. Needs evt-type = <INPUT_EV_REL>, and a
      pixart,pmw3610-alt-xy-unpack node on the side that receives the events.
```
